// SPDX-License-Identifier: GPL-2.0-or-later OR MIT

#include "qcom-ipq4019.dtsi"
#include <dt-bindings/gpio/gpio.h>
#include <dt-bindings/input/input.h>
#include <dt-bindings/leds/common.h>
#include <dt-bindings/soc/qcom,tcsr.h>

/ {
	model = "Huawei AP4050DN";
	compatible = "huawei,ap4050dn";

	chosen {
		bootargs = "console=ttyMSM0,9600n8";
	};

	watchdog {
		compatible = "linux,wdt-gpio";
		gpios = <&tlmm 15 GPIO_ACTIVE_LOW>;
		hw_algo = "toggle";
		hw_margin_ms = <100>;
		always-running;
	};
};

&blsp1_uart1 {
	pinctrl-0 = <&serial_pins>;
	pinctrl-names = "default";
	status = "okay";
};
